/dts-v1/;

/ {
        compatible = "radxa,zero\0amlogic,g12a";

        fragment@0 {
                target = < 0xffffffff >;

                __overlay__ {
                        status = "okay";
                        pinctrl-0 = < 0xffffffff 0xffffffff >;
                        pinctrl-names = "default";
                };
        };

        __fixups__ {
                i2c1 = "/fragment@0:target:0";
                i2c1_sda_h6_pins = "/fragment@0/__overlay__:pinctrl-0:0";
                i2c1_sck_h7_pins = "/fragment@0/__overlay__:pinctrl-0:4";
        };
};
